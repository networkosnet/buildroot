## package/lzma/Config.in.host
```kconfig
config BR2_PACKAGE_HOST_LEGACY_LZMA
    bool "host legacy lzma"
    help
      Legacy LZMA utilities.

      http://tukaani.org/lzma/
```

## package/netd/Config.in
```kconfig
config BR2_PACKAGE_NETD
    bool "netd"
    select BR2_HOST_NIM
    select BR2_PACKAGE_IPROUTE2
    select BR2_PACKAGE_PCRE
    help
        netd advanced network manager
```

## package/nim/Config.in.host
```kconfig
config BR2_PACKAGE_HOST_NIM
    bool "host nim"
    help
      Nim programming language.

      http://nim-lang.org/
```
